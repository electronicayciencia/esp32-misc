## i2s-clocking/esp32/sdkconfig.defaults
```kconfig
CONFIG_IDF_TARGET="esp32"
CONFIG_COMPILER_MINIMAL_BUILD=y
CONFIG_ESP32_DEFAULT_CPU_FREQ_240=y
CONFIG_I2S_ENABLE_STATIC_CHANNELS=y
CONFIG_I2S_SUPPORT_APLL=y
CONFIG_BT_ENABLED=n
CONFIG_WIFI_ENABLED=n
CONFIG_FREERTOS_UNICORE=n
```

## i2s-clocking/esp32c3/sdkconfig.defaults
```kconfig
CONFIG_IDF_TARGET="esp32c3"
CONFIG_COMPILER_MINIMAL_BUILD=y
CONFIG_ESP32C3_DEFAULT_CPU_FREQ_160=y
CONFIG_I2S_ENABLE_STATIC_CHANNELS=y
CONFIG_LOG_DEFAULT_LEVEL_NONE=y
CONFIG_BT_ENABLED=n
CONFIG_WIFI_ENABLED=n
CONFIG_BOOTLOADER_LOG_LEVEL_NONE=y
CONFIG_APP_LOG_LEVEL_NONE=y
CONFIG_ESP_MAIN_TASK_STACK_SIZE=1536
```

## i2s/esp32c3/sdkconfig.defaults
```kconfig
CONFIG_IDF_TARGET="esp32c3"
CONFIG_COMPILER_MINIMAL_BUILD=y
CONFIG_ESP32C3_DEFAULT_CPU_FREQ_160=y
CONFIG_I2S_ENABLE_STATIC_CHANNELS=y
CONFIG_BT_ENABLED=n
CONFIG_WIFI_ENABLED=n
```
